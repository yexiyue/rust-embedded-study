## sdkconfig.defaults
```kconfig
# Rust often needs a bit of an extra main task stack size compared to C (the default is 3K)
CONFIG_ESP_MAIN_TASK_STACK_SIZE=8000

# Use this to set FreeRTOS kernel tick frequency to 1000 Hz (100 Hz by default).
# This allows to use 1 ms granuality for thread sleeps (10 ms by default).
#CONFIG_FREERTOS_HZ=1000

# Workaround for https://github.com/espressif/esp-idf/issues/7631
#CONFIG_MBEDTLS_CERTIFICATE_BUNDLE=n
#CONFIG_MBEDTLS_CERTIFICATE_BUNDLE_DEFAULT_FULL=n
#CONFIG_BT_ENABLED=y
#CONFIG_BT_BLUEDROID_ENABLED=y
#CONFIG_BT_CLASSIC_ENABLED=n
#CONFIG_BTDM_CTRL_MODE_BLE_ONLY=y
#CONFIG_BTDM_CTRL_MODE_BR_EDR_ONLY=n
#CONFIG_BTDM_CTRL_MODE_BTDM=n
#CONFIG_BT_BLE_42_FEATURES_SUPPORTED=y
#CONFIG_BT_BLE_50_FEATURES_SUPPORTED=n
#CONFIG_BT_BTC_TASK_STACK_SIZE=15000
#CONFIG_BT_BLE_DYNAMIC_ENV_MEMORY=y

# esp32-nimble
CONFIG_BT_ENABLED=y
CONFIG_BT_BLE_ENABLED=y
CONFIG_BT_BLUEDROID_ENABLED=n
CONFIG_BT_NIMBLE_ENABLED=y
CONFIG_BT_NIMBLE_NVS_PERSIST=y
CONFIG_BT_NIMBLE_HOST_TASK_STACK_SIZE=7000 
```
